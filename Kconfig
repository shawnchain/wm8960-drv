## Kconfig
```kconfig
config SND_SOC_WM8960_X
	tristate "ASoC support for wm8960(ported by BG5HHP)"
	depends on I2C
	help
	  Say Y or M if you want to add support for codecs attached to
	  the WM8960 Soundcard device. You will also need to
	  select the audio interfaces to support below.

config SND_SOC_WM8960_SOUNDCARD
	tristate "WM8960 Soundcard Device Driver(ported by BG5HHP)"
	depends on SND_SOC_WM8960_X
	help
	  Say Y or M if you want to add support for WM8960 soundcard device.
```
